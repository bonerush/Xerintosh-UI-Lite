/**
 * @file   hal_display_font.cpp
 * @brief  HAL 显示层字体与文本实现
 * @details 字体设置、字符串绘制、文本宽度/高度查询、中文字体句柄。
 *
 * @copyright Copyright (c) 2026
 */

#include "hal_display.h"
#include <string.h>
#include <stdlib.h>

#ifdef NATIVE_TEST

/* 6x8 固定宽度 ASCII 字体：每个字符 8 字节，每字节一行 */
static const uint8_t g_font_6x8[128][8] = {
    {0x00,0x00,0x00,0x00,0x00,0x00,0x00,0x00},
    {0x00,0x00,0x00,0x00,0x00,0x00,0x00,0x00},
    {0x00,0x00,0x00,0x00,0x00,0x00,0x00,0x00},
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    {0xFF,0xFF,0xFF,0xFF,0xFF,0xFF,0xFF,0xFF},
};

#define FONT_W 6
#define FONT_H 8

uint16_t *g_font_fb = NULL;
int16_t  g_font_fb_w = 0;
int16_t  g_font_fb_h = 0;

static void font_fb_init_once(void)
{
    if (g_font_fb == NULL) {
        g_font_fb_w = HAL_SCREEN_WIDTH;
        g_font_fb_h = HAL_SCREEN_HEIGHT;
        g_font_fb = (uint16_t*)calloc(g_font_fb_w * g_font_fb_h, sizeof(uint16_t));
    }
}

static void font_draw_char(int16_t x, int16_t y, char c, uint16_t color)
{
    if (x + FONT_W < 0 || x >= HAL_SCREEN_WIDTH || y + FONT_H < 0 || y >= HAL_SCREEN_HEIGHT) return;
    if (c < 0 || c > 127) return;
    font_fb_init_once();
    const uint8_t *bm = g_font_6x8[(uint8_t)c];
    for (int16_t row = 0; row < FONT_H; row++) {
        uint8_t bits = bm[row];
        for (int16_t col = 0; col < FONT_W; col++) {
            if (bits & (1 << (7 - col))) {
                int16_t px = x + col;
                int16_t py = y + row;
                if (px >= 0 && px < HAL_SCREEN_WIDTH && py >= 0 && py < HAL_SCREEN_HEIGHT) {
                    g_font_fb[py * HAL_SCREEN_WIDTH + px] = color;
                }
            }
        }
    }
}



/**
 * @brief 设置当前字体（native 桩：忽略字体参数）
 */
void hal_set_font(const void* font) {
    (void)font;
}

/**
 * @brief 绘制 ASCII 字符串（native：6×8 位图字体写入字体层）
 */
void hal_draw_string(int16_t x, int16_t y, const char* str, uint16_t color) {
    if (!str) return;
    font_fb_init_once();
    int16_t cx = x;
    int16_t cy = y - FONT_H + 1;
    while (*str) {
        if (*str == '\n') {
            cx = x;
            cy += FONT_H;
            str++;
            continue;
        }
        font_draw_char(cx, cy, *str, color);
        cx += FONT_W + 1;
        str++;
    }
}

/**
 * @brief 获取 ASCII 字符串宽度（native：按 6×8 位图字体计算）
 */
int16_t hal_get_string_width(const char* str) {
    if (!str) return 0;
    size_t len = strlen(str);
    return (int16_t)(len * (FONT_W + 1));
}

/**
 * @brief 获取当前字体高度（native：返回固定值 8）
 */
int16_t hal_get_font_height(void) {
    return FONT_H;
}

/**
 * @brief 获取中文字体指针（native 桩：返回 NULL）
 */
const void* hal_get_cn_font(void) {
    return NULL;
}


#else

/* ═══ 硬件环境：LovyanGFX 加速 ═══ */

#include <LovyanGFX.hpp>

extern lgfx::LGFX_Sprite* g_canvas;

void hal_set_font(const void* font) {
    if (!g_canvas) return;
    if (font)
        g_canvas->setFont((const lgfx::v1::IFont*)font);
    else
        g_canvas->setFont(&fonts::Font0);
}

/**
 * @brief 绘制 ASCII 字符串
 */
void hal_draw_string(int16_t x, int16_t y, const char* str, uint16_t color) {
    if (!g_canvas || !str) return;
    g_canvas->setTextColor(color);
    g_canvas->setTextDatum(lgfx::v1::baseline_left);

    const char *p = str;
    const char *line_start = p;
    int16_t line_y = y;
    int16_t font_h = g_canvas->fontHeight();

    while (1) {
        if (*p == '\n' || *p == '\0') {
            size_t len = p - line_start;
            if (len > 0) {
                char buf[256];
                if (len >= sizeof(buf)) len = sizeof(buf) - 1;
                memcpy(buf, line_start, len);
                buf[len] = '\0';
                g_canvas->drawString(buf, x, line_y);
            }
            if (*p == '\0') break;
            line_y += font_h;
            line_start = ++p;
        } else {
            p++;
        }
    }
}

/**
 * @brief 获取 ASCII 字符串宽度
 */
int16_t hal_get_string_width(const char* str) {
    if (!g_canvas || !str) return 0;
    return g_canvas->textWidth(str);
}

/**
 * @brief 获取当前字体高度
 */
int16_t hal_get_font_height(void) {
    if (!g_canvas) return 8;
    return g_canvas->fontHeight();
}

#endif
